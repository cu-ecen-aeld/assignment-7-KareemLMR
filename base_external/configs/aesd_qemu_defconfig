## base_external/configs/aesd_qemu_defconfig
```kconfig
BR2_aarch64=y
BR2_KERNEL_HEADERS_5_10=y
BR2_TARGET_GENERIC_ROOT_PASSWD="root"
BR2_ROOTFS_OVERLAY="../base_external/rootfs_overlay"
BR2_LINUX_KERNEL=y
BR2_LINUX_KERNEL_LATEST_CIP_VERSION=y
BR2_LINUX_KERNEL_USE_ARCH_DEFAULT_CONFIG=y
BR2_PACKAGE_CONNMAN=y
BR2_PACKAGE_DROPBEAR=y
BR2_TARGET_ROOTFS_EXT2=y
BR2_TARGET_ROOTFS_EXT2_4=y
BR2_TARGET_ROOTFS_EXT2_SIZE="1G"
BR2_PACKAGE_AESD_ASSIGNMENTS=y
BR2_PACKAGE_LDD=y
BR2_PACKAGE_MODULE=y
```

## base_external/package/ldd/Config.in
```kconfig
config BR2_PACKAGE_LDD
	bool "ldd"
	help
	  Includes the misc-module and scull components in the kernel image.
	  Used to understand buildroot external trees and package builds.
```

## base_external/package/module/Config.in
```kconfig
config BR2_PACKAGE_MODULE
	bool "module"
	help
	  Includes the misc-modules in the kernel image.
	  Used to understand buildroot external trees and package builds.
```
